## Documentation/devicetree/bindings/firmware/qcom,scm.yaml
```yaml
# SPDX-License-Identifier: (GPL-2.0 OR BSD-2-Clause)
%YAML 1.2
---
$id: http://devicetree.org/schemas/firmware/qcom,scm.yaml#
$schema: http://devicetree.org/meta-schemas/core.yaml#

title: QCOM Secure Channel Manager (SCM) bindings

maintainers:
  - Robert Marko <robimarko@gmail.com>

description: |
  Qualcomm processors include an interface to communicate to the secure firmware.
  This interface allows for clients to request different types of actions.
  These can include CPU power up/down, HDCP requests, loading of firmware, and
  other assorted actions.

properties:
  compatible:
    oneOf:
      - items:
          - enum:
              - qcom,scm-apq8064
              - qcom,scm-apq8084
              - qcom,scm-ipq4019
              - qcom,scm-ipq806x
              - qcom,scm-ipq8074
              - qcom,scm-mdm9607
              - qcom,scm-msm8226
              - qcom,scm-msm8660
              - qcom,scm-msm8916
              - qcom,scm-msm8953
              - qcom,scm-msm8960
              - qcom,scm-msm8974
              - qcom,scm-msm8976
              - qcom,scm-msm8994
              - qcom,scm-msm8996
              - qcom,scm-msm8998
              - qcom,scm-qcs404
              - qcom,scm-sc7180
              - qcom,scm-sc7280
              - qcom,scm-sdm845
              - qcom,scm-sdx55
              - qcom,scm-sm6125
              - qcom,scm-sm6350
              - qcom,scm-sm8150
              - qcom,scm-sm8250
              - qcom,scm-sm8350
              - qcom,scm-sm8450
          - const: qcom,scm

  clocks: true

  clock-names: true

  '#reset-cells':
    const: 1

  qcom,dload-mode:
    $ref: /schemas/types.yaml#/definitions/phandle-array
    description:
      Phandle to the TCSR hardware block and offset of the download mode control register

required:
  - compatible

allOf:
  - if:
      properties:
        compatible:
          contains:
            enum:
              - qcom,scm-apq8064
              - qcom,scm-msm8660
              - qcom,scm-msm8960
    then:
      properties:
        clocks:
          items:
            - description: SCM core clock
        clock-names:
          items:
            - const: core

  - if:
      properties:
        compatible:
          contains:
            enum:
              - qcom,scm-apq8084
              - qcom,scm-mdm9607
              - qcom,scm-msm8916
              - qcom,scm-msm8953
              - qcom,scm-msm8974
              - qcom,scm-msm8976
    then:
      properties:
        clocks:
          items:
            - description: SCM core clock
            - description: SCM bus clock
            - description: SCM interface clock
        clock-names:
          items:
            - const: core
            - const: bus
            - const: iface

additionalProperties: false

examples:
  - |
    #include <dt-bindings/clock/qcom,gcc-msm8916.h>
    firmware {
      scm {
        compatible = "qcom,scm-msm8916", "qcom,scm";

        clocks = <&gcc GCC_CRYPTO_CLK>,
                 <&gcc GCC_CRYPTO_AXI_CLK>,
                 <&gcc GCC_CRYPTO_AHB_CLK>;
        clock-names = "core", "bus", "iface";
        qcom,dload-mode = <&tcsr 0x6100>;
      };
    };
```

## Documentation/devicetree/bindings/mfd/qcom,spmi-pmic.yaml
```yaml
# SPDX-License-Identifier: (GPL-2.0 OR BSD-2-Clause)
%YAML 1.2
---
$id: http://devicetree.org/schemas/mfd/qcom,spmi-pmic.yaml#
$schema: http://devicetree.org/meta-schemas/core.yaml#

title: Qualcomm SPMI PMIC bindings

maintainers:
  - Robert Marko <robimarko@gmail.com>

description: |
  The Qualcomm SPMI series presently includes PM8941, PM8841 and PMA8084
  PMICs.  These PMICs use a QPNP scheme through SPMI interface.
  QPNP is effectively a partitioning scheme for dividing the SPMI extended
  register space up into logical pieces, and set of fixed register
  locations/definitions within these regions, with some of these regions
  specifically used for interrupt handling.

  The QPNP PMICs are used with the Qualcomm Snapdragon series SoCs, and are
  interfaced to the chip via the SPMI (System Power Management Interface) bus.
  Support for multiple independent functions are implemented by splitting the
  16-bit SPMI slave address space into 256 smaller fixed-size regions, 256 bytes
  each. A function can consume one or more of these fixed-size register regions.

properties:
  compatible:
    items:
      - enum:
          - qcom,pm6150
          - qcom,pm6150l
          - qcom,pm6350
          - qcom,pm660
          - qcom,pm660l
          - qcom,pm7325
          - qcom,pm8004
          - qcom,pm8005
          - qcom,pm8009
          - qcom,pm8019
          - qcom,pm8028
          - qcom,pm8110
          - qcom,pm8150
          - qcom,pm8150b
          - qcom,pm8150c
          - qcom,pm8150l
          - qcom,pm8226
          - qcom,pm8350
          - qcom,pm8350b
          - qcom,pm8350c
          - qcom,pm8841
          - qcom,pm8901
          - qcom,pm8909
          - qcom,pm8916
          - qcom,pm8941
          - qcom,pm8950
          - qcom,pm8953
          - qcom,pm8994
          - qcom,pm8998
          - qcom,pma8084
          - qcom,pmd9635
          - qcom,pmi8950
          - qcom,pmi8962
          - qcom,pmi8994
          - qcom,pmi8998
          - qcom,pmk8002
          - qcom,pmk8350
          - qcom,pmm8155au
          - qcom,pmp8074
          - qcom,pmr735a
          - qcom,pmr735b
          - qcom,pms405
          - qcom,smb2351
      - const: qcom,spmi-pmic

  reg:
    description: SPMI USID device address
    maxItems: 1

  '#address-cells':
    const: 1

  '#size-cells':
    const: 0

required:
  - compatible
  - reg

additionalProperties: true

examples:
  - |
    #include <dt-bindings/interrupt-controller/irq.h>
    #include <dt-bindings/spmi/spmi.h>
    spmi {
      #address-cells = <2>;
      #size-cells = <0>;

      pmic@0 {
        compatible = "qcom,pm8941", "qcom,spmi-pmic";
        reg = <0x0 SPMI_USID>;
        #address-cells = <1>;
        #size-cells = <0>;

        rtc@6000 {
          compatible = "qcom,pm8941-rtc";
          reg = <0x6000>, <0x6100>;
          reg-names = "rtc", "alarm";
          interrupts = <0x0 0x61 0x1 IRQ_TYPE_EDGE_RISING>;
        };
      };

      pmic@1 {
        compatible = "qcom,pm8941", "qcom,spmi-pmic";
        reg = <0x1 SPMI_USID>;

        regulators {
          compatible = "qcom,pm8941-regulators";
        };
      };
    };
```

## Documentation/devicetree/bindings/net/sff,sfp.yaml
```yaml
# SPDX-License-Identifier: GPL-2.0-only OR BSD-2-Clause
%YAML 1.2
---
$id: http://devicetree.org/schemas/net/sff,sfp.yaml#
$schema: http://devicetree.org/meta-schemas/core.yaml#

title: Small Form Factor (SFF) Committee Small Form-factor Pluggable (SFP) Transceiver

maintainers:
  - Robert Marko <robimarko@gmail.com>

properties:
  compatible:
    enum:
      # for SFP modules
      - sff,sfp
      # for soldered down SFF modules
      - sff,sff

  i2c-bus:
    description: phandle of an I2C bus controller for the SFP two wire serial interface
    $ref: /schemas/types.yaml#/definitions/phandle

  mod-def0-gpios:
    maxItems: 1
    description:
      GPIO phandle and a specifier of the MOD-DEF0 (AKA Mod_ABS)
      module presence input gpio signal, active (module absent) high.
      Must not be present for SFF modules.

  los-gpios:
    maxItems: 1
    description:
      GPIO phandle and a specifier of the Receiver Loss of Signal
      Indication input gpio signal, active (signal lost) high.

  tx-fault-gpios:
    maxItems: 1
    description:
      GPIO phandle and a specifier of the Module Transmitter
      Fault input gpio signal, active (fault condition) high.

  tx-disable-gpios:
    maxItems: 1
    description:
      GPIO phandle and a specifier of the Transmitter Disable
      output gpio signal, active (Tx disable) high.

  rate-select0-gpios:
    maxItems: 1
    description:
      GPIO phandle and a specifier of the Rx Signaling Rate
      Select (AKA RS0) output gpio signal, low (low) Rx rate, high (high) Rx rate.
      Must not be present for SFF modules.

  rate-select1-gpios:
    maxItems: 1
    description:
      GPIO phandle and a specifier of the Tx Signaling Rate
      Select (AKA RS1) output gpio signal (SFP+ only), low (low) Tx rate, high (high) Tx rate.
      Must not be present for SFF modules.

  maximum-power-milliwatt:
    description:
      Maximum module power consumption.
      Specifies the maximum power consumption allowable by a module in the slot, in milli-Watts.
    $ref: /schemas/types.yaml#/definitions/uint32

required:
  - compatible
  - i2c-bus

unevaluatedProperties: false

examples:
  - |
    #include <dt-bindings/gpio/gpio.h>
    sfp_eth3: sfp-eth3 {
      compatible = "sff,sfp";
      i2c-bus = <&sfp_1g_i2c>;
      los-gpios = <&cpm_gpio2 22 GPIO_ACTIVE_HIGH>;
      mod-def0-gpios = <&cpm_gpio2 21 GPIO_ACTIVE_LOW>;
      tx-disable-gpios = <&cps_gpio1 24 GPIO_ACTIVE_HIGH>;
      tx-fault-gpios = <&cpm_gpio2 19 GPIO_ACTIVE_HIGH>;
      maximum-power-milliwatt = <1000>;
    };
...
```

## Documentation/devicetree/bindings/regulator/qcom,spmi-regulator.yaml
```yaml
# SPDX-License-Identifier: (GPL-2.0 OR BSD-2-Clause)
%YAML 1.2
---
$id: http://devicetree.org/schemas/regulator/qcom,spmi-regulator.yaml#
$schema: http://devicetree.org/meta-schemas/core.yaml#

title: Qualcomm SPMI Regulators

maintainers:
  - Robert Marko <robert.marko@sartura.hr>

properties:
  compatible:
    enum:
      - qcom,pm660-regulators
      - qcom,pm660l-regulators
      - qcom,pm8004-regulators
      - qcom,pm8005-regulators
      - qcom,pm8226-regulators
      - qcom,pm8841-regulators
      - qcom,pm8916-regulators
      - qcom,pm8941-regulators
      - qcom,pm8950-regulators
      - qcom,pm8994-regulators
      - qcom,pmi8994-regulators
      - qcom,pmp8074-regulators
      - qcom,pms405-regulators

  qcom,saw-reg:
    description: Reference to syscon node defining the SAW registers
    $ref: "/schemas/types.yaml#/definitions/phandle"

allOf:
  - if:
      properties:
        compatible:
          contains:
            enum:
              - qcom,pm8941-regulators
    then:
      properties:
        interrupts:
          items:
            - description: Over-current protection interrupt for 5V S1
            - description: Over-current protection interrupt for 5V S2
        interrupt-names:
          items:
            - const: ocp-5vs1
            - const: ocp-5vs2

patternProperties:
  ".*-supply$":
    description: Input supply phandle(s) for this node
    $ref: "/schemas/types.yaml#/definitions/phandle"

  "^((s|l|lvs|5vs)[0-9]*)$":
    description: List of regulators and its properties
    $ref: regulator.yaml#

    properties:
      qcom,ocp-max-retries:
        description:
          Maximum number of times to try toggling a voltage switch off and
          back on as a result of consecutive over current events
        $ref: "/schemas/types.yaml#/definitions/uint32"

      qcom,ocp-retry-delay:
        description:
          Time to delay in milliseconds between each voltage switch toggle
          after an over current event takes place
        $ref: "/schemas/types.yaml#/definitions/uint32"

      qcom,pin-ctrl-enable:
        description:
          Bit mask specifying which hardware pins should be used to enable the
          regulator, if any.
          Supported bits are
          0 = ignore all hardware enable signals
          BIT(0) = follow HW0_EN signal
          BIT(1) = follow HW1_EN signal
          BIT(2) = follow HW2_EN signal
          BIT(3) = follow HW3_EN signal
        $ref: "/schemas/types.yaml#/definitions/uint32"
        minimum: 0
        maximum: 15

      qcom,pin-ctrl-hpm:
        description:
          Bit mask specifying which hardware pins should be used to force the
          regulator into high power mode, if any.
          Supported bits are
          0 = ignore all hardware enable signals
          BIT(0) = follow HW0_EN signal
          BIT(1) = follow HW1_EN signal
          BIT(2) = follow HW2_EN signal
          BIT(3) = follow HW3_EN signal
          BIT(4) = follow PMIC awake state
        $ref: "/schemas/types.yaml#/definitions/uint32"
        minimum: 0
        maximum: 31

      qcom,vs-soft-start-strength:
        description:
          This property sets the soft start strength for voltage switch type
          regulators.
          Supported values are
          0 = 0.05 uA
          1 = 0.25 uA
          2 = 0.55 uA
          3 = 0.75 uA
        $ref: "/schemas/types.yaml#/definitions/uint32"
        minimum: 0
        maximum: 3

      qcom,saw-slave:
        description: SAW controlled gang slave. Will not be configured.
        type: boolean

      qcom,saw-leader:
        description:
          SAW controlled gang leader. Will be configured as SAW regulator.
        type: boolean

      unevaluatedProperties: false

unevaluatedProperties: false

required:
  - compatible

examples:
  - |
    regulators {
      compatible = "qcom,pm8941-regulators";
      vdd_l1_l3-supply = <&s1>;

      s1: s1 {
        regulator-min-microvolt = <1300000>;
        regulator-max-microvolt = <1400000>;
      };

      l1: l1 {
        regulator-min-microvolt = <1225000>;
        regulator-max-microvolt = <1300000>;
      };
    };

  - |
    saw3: syscon@9a10000 {
      compatible = "syscon";
      reg = <0x9a10000 0x1000>;
    };

    regulators {
      compatible = "qcom,pm8994-regulators";
      qcom,saw-reg = <&saw3>;

      s8 {
        qcom,saw-slave;
      };

      s9 {
        qcom,saw-slave;
      };

      s10 {
        qcom,saw-slave;
      };

      pm8994_s11_saw: s11 {
        qcom,saw-leader;
        regulator-always-on;
        regulator-min-microvolt = <900000>;
        regulator-max-microvolt = <1140000>;
      };
    };
...
```
